## arch/arm64/configs/merge_hi6250_defconfig
```kconfig
# CONFIG_LOCALVERSION_AUTO is not set
# CONFIG_FHANDLE is not set
CONFIG_AUDIT=y
CONFIG_NO_HZ=y
CONFIG_HIGH_RES_TIMERS=y
CONFIG_TASKSTATS=y
CONFIG_TASK_DELAY_ACCT=y
CONFIG_TASK_XACCT=y
CONFIG_TASK_IO_ACCOUNTING=y
CONFIG_RCU_EXPERT=y
CONFIG_RCU_FAST_NO_HZ=y
CONFIG_IKCONFIG=y
CONFIG_IKCONFIG_PROC=y
CONFIG_LOG_BUF_SHIFT=20
CONFIG_BOOST_KILL=y
CONFIG_CGROUPS=y
CONFIG_CGROUP_FREEZER=y
CONFIG_HW_CGROUP_PIDS=y
CONFIG_CGROUP_IOLIMIT=y
CONFIG_CPUSETS=y
CONFIG_CGROUP_CPUACCT=y
CONFIG_CGROUP_SCHEDTUNE=y
CONFIG_HW_CGROUP_WORKINGSET=y
CONFIG_BLK_CGROUP=y
CONFIG_CGROUP_SCHED=y
CONFIG_RT_GROUP_SCHED=y
CONFIG_CGROUP_BPF=y
CONFIG_HISI_EAS_SCHED=y
CONFIG_HISI_RT_OPT=y
CONFIG_SCHED_TUNE=y
CONFIG_DEFAULT_USE_ENERGY_AWARE=y
CONFIG_BLK_DEV_INITRD=y
# CONFIG_RD_BZIP2 is not set
# CONFIG_RD_LZMA is not set
# CONFIG_RD_XZ is not set
# CONFIG_RD_LZO is not set
CONFIG_KALLSYMS_ALL=y
CONFIG_BPF_SYSCALL=y
# CONFIG_MEMBARRIER is not set
CONFIG_EMBEDDED=y
CONFIG_PROFILING=y
CONFIG_GCC_PLUGINS=y
CONFIG_CC_STACKPROTECTOR_STRONG=y
CONFIG_MODULES=y
CONFIG_MODULE_UNLOAD=y
CONFIG_MODVERSIONS=y
CONFIG_BLK_DEV_THROTTLING=y
CONFIG_BLK_DEV_HI_PRIO_FOR_FG=y
CONFIG_HISI_BLOCK_FREQUENCE_CONTROL=y
CONFIG_HISI_BLK=y
CONFIG_HISI_BK_OPS=y
CONFIG_HISI_PARTITION=y
CONFIG_HW_SYSTEM_WR_PROTECT=y
CONFIG_HISI_PARTITION_HI6250=y
CONFIG_PARTITION_ADVANCED=y
CONFIG_IOSCHED_ROW=y
CONFIG_DEFAULT_ROW=y
CONFIG_ROW_VIP_QUEUE=y
CONFIG_HW_VIP_THREAD=y
CONFIG_HW_NETWORK_AWARE=y
CONFIG_SCHED_HISI_FORCE_CMP_BACKUP=y
CONFIG_HW_QOS_THREAD=y
CONFIG_LIVEPATCH=y
CONFIG_ARCH_HISI=y
# CONFIG_ARM64_ERRATUM_832075 is not set
# CONFIG_CAVIUM_ERRATUM_22375 is not set
# CONFIG_CAVIUM_ERRATUM_23154 is not set
# CONFIG_CAVIUM_ERRATUM_27456 is not set
# CONFIG_QCOM_QDF2400_ERRATUM_0065 is not set
# CONFIG_ARM64_ERRATUM_858921 is not set
CONFIG_SCHED_MC=y
CONFIG_NR_CPUS=8
CONFIG_PREEMPT=y
CONFIG_HZ_100=y
CONFIG_FLATMEM_MANUAL=y
CONFIG_SHRINK_MEMORY=y
CONFIG_CMA=y
CONFIG_CMA_DEBUG=y
CONFIG_ZBUD=y
CONFIG_PGTABLE_MAPPING=y
CONFIG_ZSMALLOC_STAT=y
CONFIG_PROCESS_RECLAIM=y
CONFIG_HISI_SWAP_ZDATA=y
CONFIG_HISI_DIRECT_SWAPPINESS=y
CONFIG_HUAWEI_UNMOVABLE_ISOLATE=y
CONFIG_HUAWEI_UNMOVABLE_ISOLATE1_SIZE_MBYTES=224
CONFIG_SPECULATIVE_PAGE_FAULT=y
CONFIG_HISI_MM=y
CONFIG_HISI_SLOW_PATH_COUNT=y
# CONFIG_HISI_PMALLOC is not set
CONFIG_SECCOMP=y
# CONFIG_UNMAP_KERNEL_AT_EL0 is not set
# CONFIG_HARDEN_BRANCH_PREDICTOR is not set
# CONFIG_ARM64_SSBD is not set
CONFIG_ARMV8_DEPRECATED=y
CONFIG_SWP_EMULATION=y
CONFIG_CP15_BARRIER_EMULATION=y
CONFIG_SETEND_EMULATION=y
# CONFIG_ARM64_HW_AFDBM is not set
# CONFIG_ARM64_PAN is not set
# CONFIG_ARM64_VHE is not set
# CONFIG_ARM64_UAO is not set
CONFIG_RANDOMIZE_BASE=y
CONFIG_CMDLINE="androidboot.android_dt_dir=/disabledtfstab"
CONFIG_CMDLINE_EXTEND=y
# CONFIG_EFI is not set
# CONFIG_CORE_DUMP_DEFAULT_ELF_HEADERS is not set
CONFIG_COMPAT=y
CONFIG_PM_AUTOSLEEP=y
CONFIG_PM_WAKELOCKS=y
CONFIG_PM_DEBUG=y
CONFIG_PM_ADVANCED_DEBUG=y
CONFIG_PM_TEST_SUSPEND=y
CONFIG_DPM_WATCHDOG=y
CONFIG_DPM_WATCHDOG_TIMEOUT=12
CONFIG_WQ_POWER_EFFICIENT_DEFAULT=y
CONFIG_HUAWEI_SLEEPLOG=y
CONFIG_CPU_IDLE=y
CONFIG_CPU_IDLE_MULTIPLE_DRIVERS=y
CONFIG_HISI_MULTIDRV_CPUIDLE=y
CONFIG_CPU_FREQ=y
CONFIG_CPU_FREQ_STAT=y
CONFIG_CPU_FREQ_STAT_DETAILS=y
CONFIG_CPU_FREQ_GOV_POWERSAVE=y
CONFIG_CPU_FREQ_GOV_USERSPACE=y
CONFIG_CPU_FREQ_GOV_ONDEMAND=y
CONFIG_CPU_FREQ_GOV_CONSERVATIVE=y
CONFIG_CPU_FREQ_GOV_INTERACTIVE=y
CONFIG_CPUFREQ_DT=y
CONFIG_HISI_CPUFREQ=y
CONFIG_HISI_BIG_MAXFREQ_HOTPLUG=y
CONFIG_HISI_CPUFREQ_DT=y
CONFIG_NET=y
CONFIG_PACKET=y
CONFIG_UNIX=y
CONFIG_XFRM_USER=y
CONFIG_XFRM_STATISTICS=y
CONFIG_NET_KEY=y
CONFIG_INET=y
CONFIG_IP_MULTICAST=y
CONFIG_IP_ADVANCED_ROUTER=y
CONFIG_IP_MULTIPLE_TABLES=y
CONFIG_IP_ROUTE_VERBOSE=y
CONFIG_NET_IPVTI=y
CONFIG_INET_AH=y
CONFIG_INET_ESP=y
CONFIG_INET_IPCOMP=y
CONFIG_INET_UDP_DIAG=y
CONFIG_INET_DIAG_DESTROY=y
CONFIG_TCP_CONG_ADVANCED=y
# CONFIG_TCP_CONG_BIC is not set
# CONFIG_TCP_CONG_WESTWOOD is not set
# CONFIG_TCP_CONG_HTCP is not set
CONFIG_TCP_AUTOTUNING=y
CONFIG_IPV6_ROUTER_PREF=y
CONFIG_IPV6_ROUTE_INFO=y
CONFIG_IPV6_OPTIMISTIC_DAD=y
CONFIG_INET6_AH=y
CONFIG_INET6_ESP=y
CONFIG_INET6_IPCOMP=y
CONFIG_IPV6_MIP6=y
CONFIG_IPV6_VTI=y
CONFIG_IPV6_MULTIPLE_TABLES=y
CONFIG_IPV6_SUBTREES=y
CONFIG_MPTCP=y
CONFIG_MPTCP_PM_ADVANCED=y
CONFIG_MPTCP_FULLMESH=y
CONFIG_MPTCP_SCHED_ADVANCED=y
CONFIG_MPTCP_REDUNDANT=y
CONFIG_NETFILTER=y
CONFIG_NETFILTER_NETLINK_ACCT=y
CONFIG_NF_CONNTRACK=y
CONFIG_NF_CONNTRACK_SECMARK=y
CONFIG_NF_CONNTRACK_EVENTS=y
CONFIG_NF_CT_PROTO_DCCP=y
CONFIG_NF_CT_PROTO_SCTP=y
CONFIG_NF_CT_PROTO_UDPLITE=y
CONFIG_NF_CONNTRACK_AMANDA=y
CONFIG_NF_CONNTRACK_FTP=y
CONFIG_NF_CONNTRACK_H323=y
CONFIG_NF_CONNTRACK_IRC=y
CONFIG_NF_CONNTRACK_NETBIOS_NS=y
CONFIG_NF_CONNTRACK_PPTP=y
CONFIG_NF_CONNTRACK_SANE=y
CONFIG_NF_CONNTRACK_SIP=y
CONFIG_NF_CONNTRACK_TFTP=y
CONFIG_NF_CT_NETLINK=y
CONFIG_NF_TABLES=y
CONFIG_NFT_NAT=y
CONFIG_NETFILTER_XT_TARGET_CLASSIFY=y
CONFIG_NETFILTER_XT_TARGET_CONNMARK=y
CONFIG_NETFILTER_XT_TARGET_CONNSECMARK=y
CONFIG_NETFILTER_XT_TARGET_DSCP=y
CONFIG_NETFILTER_XT_TARGET_IDLETIMER=y
CONFIG_NETFILTER_XT_TARGET_LOG=y
CONFIG_NETFILTER_XT_TARGET_MARK=y
CONFIG_NETFILTER_XT_TARGET_NFLOG=y
CONFIG_NETFILTER_XT_TARGET_NFQUEUE=y
CONFIG_NETFILTER_XT_TARGET_NOTRACK=y
CONFIG_NETFILTER_XT_TARGET_TEE=y
CONFIG_NETFILTER_XT_TARGET_TPROXY=y
CONFIG_NETFILTER_XT_TARGET_TRACE=y
CONFIG_NETFILTER_XT_TARGET_SECMARK=y
CONFIG_NETFILTER_XT_TARGET_TCPMSS=y
CONFIG_NETFILTER_XT_MATCH_BPF=y
CONFIG_NETFILTER_XT_MATCH_COMMENT=y
CONFIG_NETFILTER_XT_MATCH_CONNBYTES=y
CONFIG_NETFILTER_XT_MATCH_CONNLIMIT=y
CONFIG_NETFILTER_XT_MATCH_CONNMARK=y
CONFIG_NETFILTER_XT_MATCH_CONNTRACK=y
CONFIG_NETFILTER_XT_MATCH_DSCP=y
CONFIG_NETFILTER_XT_MATCH_ESP=y
CONFIG_NETFILTER_XT_MATCH_HASHLIMIT=y
CONFIG_NETFILTER_XT_MATCH_HELPER=y
CONFIG_NETFILTER_XT_MATCH_IPRANGE=y
CONFIG_NETFILTER_XT_MATCH_LENGTH=y
CONFIG_NETFILTER_XT_MATCH_LIMIT=y
CONFIG_NETFILTER_XT_MATCH_MAC=y
CONFIG_NETFILTER_XT_MATCH_MARK=y
CONFIG_NETFILTER_XT_MATCH_MULTIPORT=y
CONFIG_NETFILTER_XT_MATCH_POLICY=y
CONFIG_NETFILTER_XT_MATCH_PKTTYPE=y
CONFIG_NETFILTER_XT_MATCH_QTAGUID=y
CONFIG_NETFILTER_XT_MATCH_QUOTA=y
CONFIG_NETFILTER_XT_MATCH_QUOTA2=y
CONFIG_NETFILTER_XT_MATCH_QUOTA2_LOG=y
CONFIG_NETFILTER_XT_MATCH_SOCKET=y
CONFIG_NETFILTER_XT_MATCH_STATE=y
CONFIG_NETFILTER_XT_MATCH_STATISTIC=y
CONFIG_NETFILTER_XT_MATCH_STRING=y
CONFIG_NETFILTER_XT_MATCH_TIME=y
CONFIG_NETFILTER_XT_MATCH_U32=y
CONFIG_NF_CONNTRACK_IPV4=y
CONFIG_IP_NF_IPTABLES=y
CONFIG_IP_NF_MATCH_AH=y
CONFIG_IP_NF_MATCH_ECN=y
CONFIG_IP_NF_MATCH_TTL=y
CONFIG_IP_NF_FILTER=y
CONFIG_IP_NF_TARGET_REJECT=y
CONFIG_IP_NF_TARGET_SYNPROXY=y
CONFIG_IP_NF_NAT=y
CONFIG_IP_NF_TARGET_MASQUERADE=y
CONFIG_IP_NF_TARGET_NETMAP=y
CONFIG_IP_NF_TARGET_REDIRECT=y
CONFIG_IP_NF_MANGLE=y
CONFIG_IP_NF_RAW=y
CONFIG_IP_NF_SECURITY=y
CONFIG_IP_NF_ARPTABLES=y
CONFIG_IP_NF_ARPFILTER=y
CONFIG_IP_NF_ARP_MANGLE=y
CONFIG_NF_CONNTRACK_IPV6=y
CONFIG_NF_TABLES_IPV6=y
CONFIG_NFT_CHAIN_ROUTE_IPV6=y
CONFIG_NFT_CHAIN_NAT_IPV6=y
CONFIG_IP6_NF_IPTABLES=y
CONFIG_IP6_NF_MATCH_RPFILTER=y
CONFIG_IP6_NF_FILTER=y
CONFIG_IP6_NF_TARGET_REJECT=y
CONFIG_IP6_NF_TARGET_SYNPROXY=y
CONFIG_IP6_NF_MANGLE=y
CONFIG_IP6_NF_RAW=y
CONFIG_IP6_NF_NAT=y
CONFIG_IP6_NF_TARGET_MASQUERADE=y
CONFIG_NET_SCHED=y
CONFIG_NET_SCH_HTB=y
CONFIG_NET_CLS_U32=y
CONFIG_NET_EMATCH=y
CONFIG_NET_EMATCH_U32=y
CONFIG_NET_CLS_ACT=y
CONFIG_NET_ACT_POLICE=y
CONFIG_NET_ACT_GACT=y
CONFIG_NET_ACT_MIRRED=y
CONFIG_CFG80211=y
CONFIG_NL80211_TESTMODE=y
CONFIG_CFG80211_WEXT=y
CONFIG_RFKILL=y
CONFIG_HISI_BOOTDEVICE=y
CONFIG_DEVTMPFS=y
CONFIG_FW_LOADER_USER_HELPER_FALLBACK=y
CONFIG_DMA_CMA=y
CONFIG_CMA_SIZE_MBYTES=32
CONFIG_MTD=y
CONFIG_BALONG_MTD=y
CONFIG_MTD_CMDLINE_PARTS=y
CONFIG_HISI_NVE=y
CONFIG_HISI_NVE_WHITELIST=y
CONFIG_MTD_BLOCK=y
CONFIG_MTD_OOPS=y
CONFIG_MTD_BLOCK2MTD=y
CONFIG_ZRAM=y
CONFIG_BLK_DEV_LOOP=y
CONFIG_BLK_DEV_RAM=y
CONFIG_BLK_DEV_RAM_SIZE=8192
CONFIG_UID_SYS_STATS=y
CONFIG_MEMORY_STATE_TIME=y
CONFIG_SCSI=y
CONFIG_BLK_DEV_SD=y
CONFIG_MD=y
CONFIG_BLK_DEV_DM=y
CONFIG_DM_CRYPT=y
CONFIG_DM_SNAPSHOT=y
CONFIG_DM_CACHE=y
# CONFIG_DM_CACHE_SMQ is not set
CONFIG_DM_UEVENT=y
CONFIG_DM_VERITY=y
CONFIG_DM_VERITY_FEC=y
CONFIG_DM_VERITY_HW_RETRY=y
CONFIG_DM_VERITY_AVB=y
CONFIG_DM_HISI_SHA_USE_SOFT=y
CONFIG_NETDEVICES=y
CONFIG_DUMMY=y
CONFIG_TUN=y
# CONFIG_NET_VENDOR_AMAZON is not set
# CONFIG_NET_VENDOR_NETRONOME is not set
CONFIG_SMSC911X=y
CONFIG_PPP=y
CONFIG_PPP_BSDCOMP=y
CONFIG_PPP_DEFLATE=y
CONFIG_PPP_FILTER=y
CONFIG_PPP_MPPE=y
CONFIG_PPP_MULTILINK=y
CONFIG_PPPOE=y
CONFIG_PPPOLAC=y
CONFIG_PPPOPNS=y
CONFIG_PPP_ASYNC=y
CONFIG_PPP_SYNC_TTY=y
CONFIG_USB_RTL8150=y
CONFIG_USB_RTL8152=y
CONFIG_USB_USBNET=y
CONFIG_USB_NET_CDC_EEM=y
CONFIG_USB_NET_CDC_MBIM=y
CONFIG_USB_NET_DM9601=y
CONFIG_USB_NET_SMSC75XX=y
CONFIG_USB_NET_SMSC95XX=y
CONFIG_USB_NET_GL620A=y
CONFIG_USB_NET_PLUSB=y
CONFIG_USB_NET_MCS7830=y
CONFIG_USB_NET_RNDIS_HOST=y
# CONFIG_USB_BELKIN is not set
# CONFIG_USB_ARMLINUX is not set
CONFIG_USB_IPHETH=y
# CONFIG_WLAN is not set
CONFIG_INPUT_EVDEV=y
CONFIG_KEYBOARD_HISI_GPIO_KEY=y
CONFIG_VOLUME_KEY_MASK=y
CONFIG_HISI_VOLUMEKEY_COMBINATION=y
# CONFIG_MOUSE_PS2_BYD is not set
CONFIG_INPUT_TOUCHSCREEN=y
CONFIG_INPUT_MISC=y
CONFIG_HISI_POWERKEY_SSI=y
CONFIG_INPUT_UINPUT=y
CONFIG_INPUT_GPIO=y
CONFIG_HISI_VIBRATOR=y
# CONFIG_VT is not set
# CONFIG_LEGACY_PTYS is not set
CONFIG_HISI_TTY=y
# CONFIG_DEVMEM is not set
# CONFIG_DEVKMEM is not set
CONFIG_SERIAL_AMBA_PL011=y
CONFIG_SERIAL_AMBA_PL011_CONSOLE=y
CONFIG_HISI_UART_OVERSAMPLING=y
# CONFIG_HW_RANDOM is not set
CONFIG_ACM=y
CONFIG_ACM_DSM=y
CONFIG_I2C_DESIGNWARE_PLATFORM=y
CONFIG_HISI_I2C_DESIGNWARE=y
CONFIG_SPI=y
CONFIG_SPI_PL022=y
CONFIG_HISI_SPI=y
CONFIG_PINCTRL_SINGLE=y
CONFIG_GPIOLIB=y
CONFIG_GPIO_SYSFS=y
CONFIG_GPIO_PL061=y
CONFIG_POWER_HISI=y
CONFIG_HISI_BATTERY_DATA=y
CONFIG_HISI_BCI_BATTERY=y
CONFIG_HISI_CHARGER=y
CONFIG_BQ25892_CHARGER=y
CONFIG_SCHARGER_V200=y
CONFIG_SCHARGER_V300=y
CONFIG_HISI_COUL=y
CONFIG_HISI_COUL_HI6555V100=y
CONFIG_HISI_COUL_TEST=y
CONFIG_THERMAL=y
CONFIG_THERMAL_WRITABLE_TRIPS=y
CONFIG_THERMAL_DEFAULT_GOV_USER_SPACE=y
CONFIG_THERMAL_GOV_POWER_ALLOCATOR=y
CONFIG_CPU_THERMAL=y
CONFIG_DEVFREQ_THERMAL=y
CONFIG_HISI_IPA_THERMAL=y
CONFIG_HISI_THERMAL_TSENSOR=y
CONFIG_HISI_THERMAL_PERIPHERAL=y
CONFIG_HISI_THERMAL_SPM=y
CONFIG_HISI_THERMAL_TRIP=y
CONFIG_HISI_THERMAL_SHELL=y
CONFIG_HISI_THERMAL_AMBIENT=y
CONFIG_WATCHDOG=y
CONFIG_HISI_SP805_WATCHDOG=y
CONFIG_MFD_HISI_IP_CORE=y
CONFIG_HISI_IP_CORE=y
CONFIG_HISI_FREQ_AUTODOWN=y
CONFIG_HISI_CHARGER_POWER=y
CONFIG_HISI_PMIC=y
CONFIG_HISI_PMIC_MNTN=y
CONFIG_REGULATOR=y
CONFIG_HISI_IP_REGULATOR=y
CONFIG_REGULATOR_HI6250=y
CONFIG_REGULATOR_IP_DEBUG=y
CONFIG_HISI_REGULATOR_DEBUG=y
CONFIG_HISI_REGULATOR=y
CONFIG_HISI_CHARGER_REGULATOR=y
CONFIG_MEDIA_SUPPORT=y
CONFIG_MEDIA_CAMERA_SUPPORT=y
CONFIG_USE_CAMERA3_ARCH=y
CONFIG_HISI_CAMERA_LM3642=y
CONFIG_HISI_CAMERA_LM3642_FRONT=y
CONFIG_HISI_CAMERA_MP3331=y
CONFIG_HISI_CAMERA_MP3331_FRONT=y
CONFIG_HISI_CAMERA_AW3642=y
CONFIG_HISI_CAMERA_SCHARGER=y
CONFIG_HUAWEI_CAMERA_USE_IMX298=y
CONFIG_HUAWEI_CAMERA_USE_IMX219=y
CONFIG_HUAWEI_CAMERA_USE_HI843=y
CONFIG_HUAWEI_CAMERA_USE_IMX486HYBIRD=y
CONFIG_HUAWEI_CAMERA_USE_IMX319=y
CONFIG_HUAWEI_CAMERA_USE_IMX576=y
CONFIG_HUAWEI_CAMERA_USE_OV20880=y
CONFIG_HUAWEI_CAMERA_USE_IMX214=y
CONFIG_HUAWEI_CAMERA_USE_IMX219BND=y
CONFIG_HUAWEI_CAMERA_USE_IMX219FIG=y
CONFIG_HUAWEI_CAMERA_USE_IMX219FLA=y
CONFIG_HUAWEI_CAMERA_USE_OV8856=y
CONFIG_HUAWEI_CAMERA_USE_OV8856BND=y
CONFIG_HUAWEI_CAMERA_USE_OV8856FIG=y
CONFIG_HUAWEI_CAMERA_USE_OV8856FLA=y
CONFIG_HUAWEI_CAMERA_USE_GC2375BND=y
CONFIG_HUAWEI_CAMERA_USE_GC2375FIG=y
CONFIG_HUAWEI_CAMERA_USE_GC2375RNE=y
CONFIG_HUAWEI_CAMERA_USE_GC2375RNEFRONT=y
CONFIG_HUAWEI_CAMERA_USE_HI259BND=y
CONFIG_HUAWEI_CAMERA_USE_HI259FIG=y
CONFIG_HUAWEI_CAMERA_USE_HI259RNE=y
CONFIG_HUAWEI_CAMERA_USE_HI259RNEFRONT=y
CONFIG_HUAWEI_CAMERA_USE_HI843BND=y
CONFIG_HUAWEI_CAMERA_USE_HI843FIG=y
CONFIG_HUAWEI_CAMERA_USE_HI843FLA=y
CONFIG_HUAWEI_CAMERA_USE_IMX386E3=y
CONFIG_HUAWEI_CAMERA_USE_OV12870E3=y
CONFIG_HUAWEI_CAMERA_USE_OV12A10=y
CONFIG_HUAWEI_CAMERA_USE_IMX486=y
CONFIG_HUAWEI_CAMERA_USE_IMX486PIC=y
CONFIG_HUAWEI_CAMERA_USE_OV12A10PIC=y
CONFIG_HUAWEI_CAMERA_USE_OV12A10HYBIRD=y
CONFIG_HUAWEI_CAMERA_USE_OV20880BAC=y
CONFIG_HUAWEI_CAMERA_USE_IMX376=y
CONFIG_HUAWEI_CAMERA_USE_IMX376BAC=y
CONFIG_HUAWEI_CAMERA_USE_OV8858=y
CONFIG_HUAWEI_CAMERA_USE_IMX219HDN=y
CONFIG_HUAWEI_CAMERA_USE_IMX219HDN_BACK=y
CONFIG_HUAWEI_CAMERA_USE_OV16B10BND=y
CONFIG_HUAWEI_CAMERA_USE_HI846BACH2_BACK=y
CONFIG_HUAWEI_CAMERA_USE_HI846BACH2_FRONT=y
CONFIG_HUAWEI_CAMERA_USE_OV16B10RNE=y
CONFIG_HUAWEI_CAMERA_USE_IMX298RNE=y
CONFIG_HUAWEI_CAMERA_USE_IMX498RNE=y
CONFIG_HUAWEI_CAMERA_USE_IMX498=y
CONFIG_HUAWEI_CAMERA_USE_OV13855RNE=y
CONFIG_HUAWEI_CAMERA_USE_HI1333FIG=y
CONFIG_HUAWEI_CAMERA_USE_HI1333RNE=y
CONFIG_HUAWEI_CAMERA_USE_IMX258FIG=y
CONFIG_HUAWEI_CAMERA_USE_OV13855FIG=y
CONFIG_HUAWEI_CAMERA_USE_OV13855LLD=y
CONFIG_HUAWEI_CAMERA_USE_OV13855FLA=y
CONFIG_HUAWEI_CAMERA_USE_OV13855LLDS=y
CONFIG_HUAWEI_CAMERA_USE_HI1333LLD=y
CONFIG_HUAWEI_CAMERA_USE_HI1333FLA=y
CONFIG_HUAWEI_CAMERA_USE_HI1333LLDS=y
CONFIG_HUAWEI_CAMERA_USE_IMX258LLD=y
CONFIG_HUAWEI_CAMERA_USE_IMX258FLA=y
CONFIG_HUAWEI_CAMERA_USE_IMX258LLDS=y
CONFIG_HUAWEI_CAMERA_USE_HI259LLD=y
CONFIG_HUAWEI_CAMERA_USE_HI259FLA=y
CONFIG_HUAWEI_CAMERA_USE_HI259LLDS=y
CONFIG_HUAWEI_CAMERA_USE_GC2375LLD=y
CONFIG_HUAWEI_CAMERA_USE_GC2375FLA=y
CONFIG_HUAWEI_CAMERA_USE_GC2375LLDS=y
CONFIG_HUAWEI_CAMERA_USE_OV13855LLDFRONT=y
CONFIG_HUAWEI_CAMERA_USE_HI1333LLDFRONT=y
CONFIG_HUAWEI_CAMERA_USE_S5K3P8LLDS=y
CONFIG_HUAWEI_CAMERA_USE_IMX371LLDS=y
CONFIG_HUAWEI_CAMERA_USE_OV16885LLDS=y
CONFIG_HUAWEI_CAMERA_USE_HI259LLDFRONT=y
CONFIG_HUAWEI_CAMERA_USE_HI259FLAFRONT=y
CONFIG_HUAWEI_CAMERA_USE_GC2375LLDFRONT=y
CONFIG_HUAWEI_CAMERA_USE_IMX258LLDFRONT=y
CONFIG_HUAWEI_CAMERA_USE_GC2375FLAFRONT=y
CONFIG_HUAWEI_CAMERA_USE_GC2375ANE=y
CONFIG_HUAWEI_CAMERA_USE_HI259ANE=y
CONFIG_HUAWEI_CAMERA_USE_OV16B10ANE=y
CONFIG_HUAWEI_CAMERA_USE_IMX498ANE=y
CONFIG_HUAWEI_CAMERA_USE_S5K3P8FLAFRONT=y
CONFIG_HUAWEI_CAMERA_USE_IMX371FLAFRONT=y
CONFIG_HUAWEI_CAMERA_USE_OV16885FLAFRONT=y
CONFIG_HUAWEI_CAMERA_USE_S5K3P8ANE=y
CONFIG_HUAWEI_CAMERA_USE_IMX371ANE=y
CONFIG_HUAWEI_CAMERA_USE_GC2375HANDEL=y
CONFIG_HUAWEI_CAMERA_USE_HI259HANDEL=y
CONFIG_HUAWEI_CAMERA_USE_IMX219HANDEL=y
CONFIG_HUAWEI_CAMERA_USE_IMX258HANDEL=y
CONFIG_HUAWEI_CAMERA_USE_OV13855HANDEL=y
CONFIG_HUAWEI_CAMERA_USE_HI1333HANDEL=y
CONFIG_HUAWEI_CAMERA_USE_OV16885=y
CONFIG_HUAWEI_CAMERA_USE_SP2509AGASSI2=y
CONFIG_HUAWEI_CAMERA_USE_GC2375AGASSI2=y
CONFIG_HUAWEI_CAMERA_USE_GC5025AGASSI2BACK=y
CONFIG_HUAWEI_CAMERA_USE_HI556AGASSI2BACK=y
CONFIG_HUAWEI_CAMERA_USE_HI846AGASSI2BACK=y
CONFIG_HISI_CAMERA_FLASH=y
CONFIG_HISI_CAMERA_HISTAR_ISPV110=y
CONFIG_IMAGINATION_D5500_VCODEC=y
CONFIG_IMAGINATION_D5500_DRM_VCODEC=y
CONFIG_FB=y
CONFIG_HISI_FB_6250=y
CONFIG_SOUND=y
CONFIG_SND=y
CONFIG_SND_USB_AUDIO=y
CONFIG_SND_SOC=y
CONFIG_SND_SOC_PCM_HI3650=y
CONFIG_SND_HI6250_HI6402=y
CONFIG_SND_HI6250_HI6555C=y
CONFIG_SND_HI3650_HI6402=y
CONFIG_SND_SOC_CODEC_HISSC=y
CONFIG_SND_SOC_CODEC_HI6555C=y
CONFIG_SND_SOC_HICODEC_DEBUG=y
CONFIG_HID_BATTERY_STRENGTH=y
CONFIG_HIDRAW=y
CONFIG_UHID=y
CONFIG_HID_A4TECH=y
CONFIG_HID_ACRUX=y
CONFIG_HID_ACRUX_FF=y
CONFIG_HID_APPLE=y
CONFIG_HID_APPLEIR=y
CONFIG_HID_AUREAL=y
CONFIG_HID_BELKIN=y
CONFIG_HID_CHERRY=y
CONFIG_HID_CHICONY=y
CONFIG_HID_PRODIKEYS=y
CONFIG_HID_CYPRESS=y
CONFIG_HID_DRAGONRISE=y
CONFIG_DRAGONRISE_FF=y
CONFIG_HID_EMS_FF=y
CONFIG_HID_ELECOM=y
CONFIG_HID_EZKEY=y
CONFIG_HID_HOLTEK=y
CONFIG_HOLTEK_FF=y
CONFIG_HID_KEYTOUCH=y
CONFIG_HID_KYE=y
CONFIG_HID_UCLOGIC=y
CONFIG_HID_WALTOP=y
CONFIG_HID_GYRATION=y
CONFIG_HID_ICADE=y
CONFIG_HID_TWINHAN=y
CONFIG_HID_KENSINGTON=y
CONFIG_HID_LCPOWER=y
CONFIG_HID_LOGITECH=y
CONFIG_HID_LOGITECH_DJ=y
CONFIG_LOGITECH_FF=y
CONFIG_LOGIRUMBLEPAD2_FF=y
CONFIG_LOGIG940_FF=y
CONFIG_HID_MAGICMOUSE=y
CONFIG_HID_MICROSOFT=y
CONFIG_HID_MONTEREY=y
CONFIG_HID_MULTITOUCH=y
CONFIG_HID_NTRIG=y
CONFIG_HID_ORTEK=y
CONFIG_HID_PANTHERLORD=y
CONFIG_PANTHERLORD_FF=y
CONFIG_HID_PETALYNX=y
CONFIG_HID_PICOLCD=y
CONFIG_HID_PICOLCD_FB=y
CONFIG_HID_PICOLCD_LEDS=y
CONFIG_HID_PRIMAX=y
CONFIG_HID_ROCCAT=y
CONFIG_HID_SAITEK=y
CONFIG_HID_SAMSUNG=y
CONFIG_HID_SONY=y
CONFIG_HID_SPEEDLINK=y
CONFIG_HID_STEELSERIES=y
CONFIG_HID_SUNPLUS=y
CONFIG_HID_GREENASIA=y
CONFIG_GREENASIA_FF=y
CONFIG_HID_SMARTJOYPLUS=y
CONFIG_SMARTJOYPLUS_FF=y
CONFIG_HID_TIVO=y
CONFIG_HID_TOPSEED=y
CONFIG_HID_THINGM=y
CONFIG_HID_THRUSTMASTER=y
CONFIG_THRUSTMASTER_FF=y
CONFIG_HID_WACOM=y
CONFIG_HID_WIIMOTE=y
CONFIG_HID_ZEROPLUS=y
CONFIG_ZEROPLUS_FF=y
CONFIG_HID_ZYDACRON=y
CONFIG_HID_SENSOR_HUB=y
CONFIG_USB=y
CONFIG_HISI_USB_SKIP_RESUME=y
CONFIG_USB_ANNOUNCE_NEW_DEVICES=y
CONFIG_USB_OTG=y
CONFIG_USB_OTG_FSM=y
CONFIG_USB_STORAGE=y
CONFIG_USB_SUSB_HDRC=y
CONFIG_DEC_USB=y
CONFIG_USB_EHSET_TEST_FIXTURE=y
CONFIG_DUAL_ROLE_USB_INTF=y
CONFIG_USB_GADGET=y
CONFIG_USB_GADGET_VBUS_DRAW=500
CONFIG_USB_MASS_STORAGE_SUPPORT_MAC=y
CONFIG_USB_CONFIGFS=y
CONFIG_USB_CONFIGFS_ACM=y
CONFIG_USB_CONFIGFS_RNDIS=y
CONFIG_USB_CONFIGFS_MASS_STORAGE=y
CONFIG_USB_CONFIGFS_F_FS=y
CONFIG_USB_CONFIGFS_F_MTP=y
CONFIG_USB_CONFIGFS_F_PTP=y
CONFIG_USB_CONFIGFS_F_ACC=y
CONFIG_USB_CONFIGFS_F_AUDIO_SRC=y
CONFIG_USB_CONFIGFS_UEVENT=y
CONFIG_USB_CONFIGFS_F_MIDI=y
CONFIG_USB_CONFIGFS_HW_ACM=y
CONFIG_HISI_USB_CONFIGFS=y
CONFIG_MMC=y
CONFIG_HISI_MMC_SECURE_RPMB=y
CONFIG_HISI_RPMB_TIME_DEBUG=y
CONFIG_HISI_MMC_FLUSH_REDUCE=y
CONFIG_HISI_MMC_MANUAL_BKOPS=y
CONFIG_HUAWEI_SDCARD_DSM=y
CONFIG_HUAWEI_EMMC_DSM=y
CONFIG_MMC_BLOCK_MINORS=48
# CONFIG_MMC_BLOCK_BOUNCE is not set
CONFIG_MMC_BLOCK_DEFERRED_RESUME=y
CONFIG_MMC_FFU=y
# CONFIG_HW_SD_HEALTH_DETECT is not set
# CONFIG_HW_SYSTEM_HW_WR_PROTECT is not set
CONFIG_SD_SCHEDULER_CFQ_ONLY=y
CONFIG_HISI_MMC_CQ_WAKE_IDLE=y
CONFIG_MMC_SDHCI=y
CONFIG_MMC_SDHCI_PLTFM=y
CONFIG_MMC_SDHCI_OF_ARASAN=y
CONFIG_MMC_DW=y
CONFIG_MMC_DW_HI3XXX=y
CONFIG_MMC_CQ_HCI=y
CONFIG_LEDS_TRIGGER_TIMER=y
CONFIG_LEDS_TRIGGER_TRANSIENT=y
CONFIG_HISI_LEDS_HWTIMER=y
CONFIG_HISI_LEDS_NODE_PERSIST=y
CONFIG_LEDS_HISI=y
CONFIG_HISI_LEDS_BLUE_TP_COLOR_SWITCH=y
CONFIG_SWITCH=y
CONFIG_RTC_CLASS=y
CONFIG_RTC_DRV_HISI_PMIC=y
CONFIG_HISI_RTC_LOG=y
CONFIG_DMADEVICES=y
CONFIG_HISI_DMA=y
CONFIG_HISI_DMA_NO_CCI=y
CONFIG_SYNC_FILE=y
CONFIG_SW_SYNC=y
CONFIG_STAGING=y
CONFIG_ASHMEM=y
CONFIG_ANDROID_LOW_MEMORY_KILLER=y
CONFIG_HUAWEI_RCC=y
CONFIG_ION_HISI=y
CONFIG_ION_HISI_SECCM=y
CONFIG_HISI_SMARTPOOL_OPT=y
CONFIG_HW_LOGGER=y
# CONFIG_COMMON_CLK_HI6220 is not set
CONFIG_HISI_CLK=y
CONFIG_HISI_HI6250_CLK=y
CONFIG_HISI_CLK_MAILBOX_SUPPORT=y
CONFIG_HISI_HWSPINLOCK=y
CONFIG_HISI_HWSPINLOCK_DEBUG=y
CONFIG_HISI_IOMMU=y
CONFIG_HISI_IOMMU_LEGACY=y
CONFIG_HISI_IOMMU_COMPACT=y
CONFIG_HISI_REMOTEPROC=y
CONFIG_HISI_HISTAR_ISP=y
CONFIG_PM_DEVFREQ=y
CONFIG_HISI_DDR_DEVFREQ=y
CONFIG_DEVFREQ_GOV_MALI_ONDEMAND=y
CONFIG_HISI_DDR_CHINTLV=y
CONFIG_MALI_T830=y
CONFIG_MALI_MIDGARD=y
# CONFIG_MALI_GATOR_SUPPORT is not set
CONFIG_MALI_MIDGARD_RT_PM=y
# CONFIG_MALI_DEVFREQ is not set
CONFIG_MALI_PM_DEMAND=y
CONFIG_ANDROID=y
CONFIG_ANDROID_BINDER_IPC=y
CONFIG_BINDER_TRANSACTION_PROC_BRIEF=y
CONFIG_HISILICON_PLATFORM=y
CONFIG_HISI_HKADC=y
CONFIG_HISI_CCI_EXTRA=y
CONFIG_HISI_CMDLINE_PARSE=y
CONFIG_HISILICON_PLATFORM_MAILBOX=y
CONFIG_HISI_MAILBOX=y
CONFIG_HISI_RPROC=y
CONFIG_HISILICON_PLATFORM_MAINTAIN=y
CONFIG_HISI_BB=y
CONFIG_HISI_LPMCU_BB=y
CONFIG_HISI_HIFI_BB=y
CONFIG_HISI_ISP_RDR=y
CONFIG_HISI_MNTN_ESUBTYPE=y
CONFIG_HIFI_DSP_ONE_TRACK=y
CONFIG_VOICE_PROXY=y
CONFIG_VOICE_PROXY_VOLTE=y
CONFIG_VOICE_PROXY_VOWIFI=y
CONFIG_HISI_BOOT_TIME=y
CONFIG_HISI_POWER_OFF=y
CONFIG_HISI_FIQ=y
CONFIG_HISI_MNTNDUMP=y
CONFIG_HISI_NOC=y
CONFIG_HISI_SYSCOUNTER=y
CONFIG_SOUND_TRIGGER=y
CONFIG_HISILICON_PLATFORM_KERNELDUMP=y
CONFIG_HISI_KERNELDUMP=y
CONFIG_DRMDRIVER=y
CONFIG_HI3XXX_EFUSE=y
CONFIG_HI6402_HIFI_MISC=y
CONFIG_HISILICON_PLATFORM_SLIMBUS=y
CONFIG_HIFI_MAILBOX=y
CONFIG_HIFI_IPC=y
CONFIG_HIFI_IPC_6250=y
CONFIG_HISILICON_PLATFORM_DDRC=y
CONFIG_HISI_DDRC_SEC=y
CONFIG_HISI_CMA=y
CONFIG_SECURE_EXTENSION=y
CONFIG_TZDRIVER=y
CONFIG_TEELOG=y
CONFIG_TEE_CPU_MIGRATION=y
# CONFIG_TEE_CFC is not set
CONFIG_TEE_LIBHWSECUREC=y
CONFIG_LOAD_IMAGE=y
CONFIG_HISI_PERFHUB=y
CONFIG_HISI_SR=y
CONFIG_HISI_SR_DEBUG=y
CONFIG_HISI_SR_DEBUG_SLEEP=y
CONFIG_HISI_SR_SYNC=y
CONFIG_HISI_GPUFREQ=y
CONFIG_HISI_BALONG_MODEM=y
CONFIG_HISI_BALONG_MODEM_HI3650=y
CONFIG_BALONG_OAM_PS=y
CONFIG_VOWIFI_NEW_FRW=y
CONFIG_IPC_DRIVER=y
CONFIG_ICC_BALONG=y
CONFIG_SEC_CALL=y
CONFIG_HARD_TIMER=y
CONFIG_SOFT_TIMER=y
CONFIG_BBP_TIMER=y
CONFIG_BALONG_MODEM_RESET=y
CONFIG_RFILE_SUPPORT=y
CONFIG_NVIM=y
CONFIG_NVIM_TEST=y
CONFIG_HW_IP_BASE_ADDR=y
CONFIG_BALONG_MODEM_ONOFF=y
CONFIG_EFUSE_BALONG_AGENT=y
CONFIG_IMAGE_LOAD=y
CONFIG_UDI_SUPPORT=y
CONFIG_MEM_BALONG=y
CONFIG_SYNC_BALONG=y
CONFIG_IPF_SUPPORT=y
CONFIG_PSAM_SUPPORT=y
CONFIG_PM_OM_BALONG=y
CONFIG_PMIC_OCP=y
CONFIG_HISI_SIM_HOTPLUG=y
CONFIG_BBP_ACORE=y
CONFIG_HISI_AXI=y
CONFIG_HISI_TIMEKEEPER=y
# CONFIG_HISI_ICS_IPU_PLATFORM is not set
CONFIG_HISI_SECS_CTRL=y
CONFIG_HUAWEI_PLATFORM=y
CONFIG_HW_ANTENNA_BOARD_MATCH=y
CONFIG_HW_ANTENNA_BOARD_ADC_MATCH=y
CONFIG_HUAWEI_AUDIO=y
CONFIG_MAXIM=y
CONFIG_TFA9895=y
CONFIG_SND_SOC_TAS2560=y
CONFIG_TAS2560_I2C=y
CONFIG_TAS2560_MISC=y
CONFIG_ANC_HS_MODULE=y
CONFIG_ANC_HS_INTERFACE=y
CONFIG_ANC_HS=y
CONFIG_AK4376_KERNEL_4_1=y
CONFIG_HIFI_VIR_DAI=y
CONFIG_CHR_NETLINK_MODULE=y
CONFIG_HWCONNECTIVITY=y
CONFIG_HW_VOWIFI=y
CONFIG_HWGPS=y
CONFIG_HUAWEI_HW_DEV_DCT=y
CONFIG_INPUTHUB=y
CONFIG_IOM3_RECOVERY=y
CONFIG_INPUTHUB_VIBRATOR_CHANNEL=y
CONFIG_HUAWEI_LCD_PANEL=y
CONFIG_HW_WIFI=y
CONFIG_HUAWEI_MSS_AUTO_CHANGE=y
CONFIG_HW_SYN_LINEAR_RETRY=y
CONFIG_HW_NETFILTER_MODULE=y
CONFIG_HW_QTAGUID_PID=y
CONFIG_HW_DPIMARK_MODULE=y
CONFIG_HUAWEI_BASTET=y
CONFIG_HUAWEI_WIFI_WEIXIN_HONGBAO_ENABLE_PRIORITY=y
CONFIG_NFC_DEVICES=y
CONFIG_PN547_NFC_64=y
# CONFIG_NFC_CXD224X is not set
CONFIG_DUAL_LOADSWITCH_RT9748=y
CONFIG_DUAL_LOADSWITCH=y
CONFIG_RT9748=y
CONFIG_LOADSWITCH=y
CONFIG_WIRED_CHANNEL_SWITCH=y
CONFIG_WIRED_CHANNEL_OVP_SWITCH=y
CONFIG_VBUS_CHANNEL=y
CONFIG_VBUS_CHANNEL_CHARGER=y
CONFIG_HUAWEI_CHARGER_AP=y
CONFIG_BQ2560X_CHARGER=y
CONFIG_RT9466_CHARGER=y
CONFIG_RT9471_CHARGER=y
CONFIG_DIRECT_CHARGER=y
CONFIG_CHARGER_PROTOCOL=y
CONFIG_CHARGER_PROTOCOL_SCP=y
CONFIG_HUAWEI_CHARGER=y
CONFIG_HUAWEI_KSTATE=y
CONFIG_HUAWEI_SMPL=y
CONFIG_HUAWEI_USB_SHORT_CIRCUIT_PROTECT=y
CONFIG_DOZE_FILTER=y
CONFIG_HW_STRICT_RST=y
CONFIG_HUAWEI_POWER_THERMALZONE=y
CONFIG_HUAWEI_SOC_CONTROL=y
CONFIG_HUAWEI_SENSORS_INPUT_INFO=y
CONFIG_FINGERPRINT=y
CONFIG_HUAWEI_HALL_INPUTHUB=y
CONFIG_DDR_INFO=y
CONFIG_PROC_APP_INFO=y
CONFIG_HUAWEI_TS=y
CONFIG_SYNAPTICS_TS=y
CONFIG_SYNAPTICS_LCD_TYPE=y
CONFIG_HUAWEI_TP_COLOR_INFO=y
CONFIG_NEMO_TOUCH_FW=y
CONFIG_VENUS_TOUCH_FW=y
CONFIG_SWITCH_FSA9685=y
CONFIG_SWITCH_USB=y
CONFIG_SWITCH_USB_CLS=y
CONFIG_FSA9685_DEBUG_FS=y
CONFIG_HUAWEI_TYPEC=y
CONFIG_HUAWEI_TYPEC_PERICOM30216=y
CONFIG_HUAWEI_TYPEC_TUSB320=y
CONFIG_HUAWEI_TYPEC_FUSB301=y
CONFIG_HUAWEI_TYPEC_PTN5150H=y
CONFIG_TCPC_CLASS=y
CONFIG_USB_POWER_DELIVERY=y
CONFIG_TCPC_RT1711=y
CONFIG_TCPC_RT1711H=y
CONFIG_TYPEC_CAP_CUSTOM_SRC2=y
CONFIG_OTG_GPIO_ID=y
CONFIG_OTG_DUAL_ROLE=y
CONFIG_POGO_PIN=y
CONFIG_HUAWEI_HISHOW=y
CONFIG_ANTENNA_BOARDID_GPIO_DETECT=y
CONFIG_HUAWEI_OCP=y
CONFIG_MADAPT=y
CONFIG_HW_LED_ALWAYSON=y
CONFIG_HUAWEI_BOOT_TIME=y
CONFIG_HW_LED_CONFIG=y
CONFIG_HUAWEI_EMCOM=y
CONFIG_HUAWEI_XENGINE=y
# CONFIG_HWAA is not set
CONFIG_HUAWEI_DSM=y
CONFIG_HUAWEI_SDCARD_VOLD=y
CONFIG_LOGGER_EXTEND=y
CONFIG_LOG_EXCEPTION=y
CONFIG_LOG_JANK=y
CONFIG_HWLOG_KERNEL=y
CONFIG_CONNECTIVITY_HI110X=y
CONFIG_HI110X_GPS_REFCLK_INTERFACE=y
CONFIG_HI110X_GPS_REFCLK_SRC_2=y
# CONFIG_HI110X_GPS_SYNC is not set
CONFIG_HI1102_PLATFORM=y
CONFIG_HI1102_WIFI=y
CONFIG_CONTEXTHUB=y
# CONFIG_CONTEXTHUB_SHMEM is not set
CONFIG_HISI_FLP=y
CONFIG_HW_GADGET=y
CONFIG_HUAWEI_BFM=y
CONFIG_HW_BFMR_HISI=y
CONFIG_HW_ZEROHUNG=y
CONFIG_HW_CGROUP_INFO=y
CONFIG_HW_FDLEAK=y
CONFIG_HW_WIFIPRO=y
CONFIG_HW_WIFIPRO_PROC=y
CONFIG_AUDIOKIT=y
CONFIG_HUAWEI_DSM_AUDIO=y
CONFIG_HUAWEI_DEVICEBOX_AUDIO=y
CONFIG_HUAWEI_SMARTPAKIT_AUDIO=y
CONFIG_LCDKIT_DRIVER=y
CONFIG_HUAWEI_TS_KIT=y
CONFIG_HUAWEI_TS_KIT_COMMON=y
CONFIG_HUAWEI_DEVKIT_HISI=y
CONFIG_FOCAL_TS_KIT=y
CONFIG_SYNAPTICS_TS_KIT=y
CONFIG_PARADE_TS_KIT=y
CONFIG_NOVATEK_TS_KIT=y
CONFIG_ILITEK_TS_KIT=y
CONFIG_NOVATEK_HYBRID_TS_KIT=y
CONFIG_ATMEL_TS_KIT=y
CONFIG_GOODIX_GT1X_TS_KIT=y
CONFIG_ELAN_TS_KIT=y
CONFIG_HUAWEI_TP_KIT_COLOR_INFO=y
CONFIG_HW_CPULOAD_NOTI=y
CONFIG_HW_MEMORY_MONITOR=y
CONFIG_HUAWEI_STORAGE_ROFA=y
CONFIG_HUAWEI_STORAGE_ROCHK=y
CONFIG_HUAWEI_DYNAMIC_BRD=y
CONFIG_HUAWEI_STORAGE_ROW=y
CONFIG_HW_RECLAIM_ACCT=y
# CONFIG_OASES is not set
CONFIG_OAE_DM_ROOT=y
CONFIG_EXT4_FS=y
CONFIG_EXT4_FS_POSIX_ACL=y
CONFIG_EXT4_FS_SECURITY=y
CONFIG_F2FS_FS=y
CONFIG_F2FS_FS_SECURITY=y
CONFIG_F2FS_FS_ENCRYPTION=y
CONFIG_HUAWEI_F2FS_DSM=y
CONFIG_F2FS_JOURNAL_APPEND=y
CONFIG_F2FS_GRADING_SSR=y
CONFIG_QUOTA=y
CONFIG_QUOTA_NETLINK_INTERFACE=y
CONFIG_QFMT_V2=y
CONFIG_FUSE_FS=y
CONFIG_OVERLAY_FS=y
CONFIG_MSDOS_FS=y
CONFIG_VFAT_FS=y
CONFIG_EXFAT_FS=y
CONFIG_EXFAT_KERNEL_DEBUG=y
CONFIG_TASK_PROTECT_LRU=y
CONFIG_HISI_PROC=y
CONFIG_HISI_PROC_HARDWARE=y
CONFIG_HISI_PROC_MEMORYINFO_FAST=y
CONFIG_TMPFS=y
CONFIG_TMPFS_POSIX_ACL=y
CONFIG_ECRYPT_FS=y
CONFIG_SDCARD_FS=y
CONFIG_SQUASHFS=y
CONFIG_SQUASHFS_DECOMP_MULTI_PERCPU=y
CONFIG_SQUASHFS_XATTR=y
CONFIG_SQUASHFS_LZ4=y
CONFIG_SQUASHFS_LZO=y
CONFIG_SQUASHFS_XZ=y
CONFIG_SQUASHFS_4K_DEVBLK_SIZE=y
CONFIG_PSTORE=y
CONFIG_PSTORE_CONSOLE=y
CONFIG_PSTORE_PMSG=y
CONFIG_PSTORE_RAM=y
CONFIG_EROFS_FS=y
CONFIG_EROFS_FS_DEBUG=y
CONFIG_EROFS_FS_SECURITY=y
CONFIG_EROFS_FS_USE_VM_MAP_RAM=y
CONFIG_EROFS_FAULT_INJECTION=y
CONFIG_EROFS_FS_ZIP=y
CONFIG_EROFS_FS_HUAWEI_EXTENSION=y
CONFIG_CIFS=y
# CONFIG_CIFS_DEBUG is not set
CONFIG_NLS_CODEPAGE_437=y
CONFIG_NLS_ISO8859_1=y
CONFIG_NLS_UTF8=y
CONFIG_PRINTK_TIME=y
CONFIG_HISI_TIME=y
CONFIG_HISI_PRINTK_EXTENSION=y
CONFIG_DEBUG_INFO=y
CONFIG_MAGIC_SYSRQ=y
CONFIG_MAGIC_SYSRQ_DEFAULT_ENABLE=0x1
CONFIG_LOCKUP_DETECTOR=y
CONFIG_DETECT_HUAWEI_HUNG_TASK=y
# CONFIG_SCHED_DEBUG is not set
CONFIG_SCHED_HWSTATUS=y
CONFIG_SCHEDSTATS=y
CONFIG_TIMER_STATS=y
# CONFIG_DEBUG_PREEMPT is not set
CONFIG_DEBUG_SPINLOCK=y
CONFIG_ENABLE_DEFAULT_TRACERS=y
CONFIG_TRACER_SNAPSHOT=y
CONFIG_TRACER_SNAPSHOT_PER_CPU_SWAP=y
CONFIG_PID_IN_CONTEXTIDR=y
CONFIG_ENCRYPTED_KEYS=y
CONFIG_SECURITY_DMESG_RESTRICT=y
CONFIG_SECURITY_PERF_EVENTS_RESTRICT=y
CONFIG_SECURITY=y
CONFIG_SECURITY_NETWORK=y
CONFIG_HARDENED_USERCOPY=y
CONFIG_HISI_HARDENED_USERCOPY_REPLACE_DIVISION=y
CONFIG_SECURITY_SELINUX=y
CONFIG_SECURITY_SELINUX_DEVELOP=y
CONFIG_SECURITY_SELINUX_CHECKREQPROT_VALUE=1
# CONFIG_INTEGRITY is not set
CONFIG_HUAWEI_HIDESYMS=y
CONFIG_HW_KERNEL_STP=y
CONFIG_CRYPTO_ECDH=y
CONFIG_CRYPTO_CCM=y
CONFIG_CRYPTO_GCM=y
CONFIG_CRYPTO_XCBC=y
CONFIG_CRYPTO_SHA512=y
CONFIG_CRYPTO_TWOFISH=y
CONFIG_CRYPTO_LZ4M=y
CONFIG_CRYPTO_ANSI_CPRNG=y
CONFIG_CRYPTO_USER_API_HASH=y
CONFIG_CRYPTO_USER_API_SKCIPHER=y
CONFIG_HIDE_SHA_CAP=y
CONFIG_ASYMMETRIC_KEY_TYPE=y
CONFIG_ASYMMETRIC_PUBLIC_KEY_SUBTYPE=y
CONFIG_X509_CERTIFICATE_PARSER=y
CONFIG_PKCS7_MESSAGE_PARSER=y
CONFIG_ARM64_CRYPTO=y
CONFIG_CRYPTO_SHA1_ARM64_CE=y
CONFIG_CRYPTO_SHA2_ARM64_CE=y
CONFIG_CRYPTO_GHASH_ARM64_CE=y
CONFIG_CRYPTO_AES_ARM64_CE_CCM=y
CONFIG_CRYPTO_AES_ARM64_CE_BLK=y
CONFIG_CRYPTO_AES_ARM64_NEON_BLK=y
CONFIG_CRYPTO_CRC32_ARM64=y
CONFIG_WBT=y
```
