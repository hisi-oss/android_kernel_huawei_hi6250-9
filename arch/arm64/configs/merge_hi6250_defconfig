## drivers/contexthub/Kconfig
```kconfig
config CONTEXTHUB
	bool "Sensor CONTEXTHUB driver"
	depends on INPUTHUB || INPUTHUB_20
	default n
	help
	Sensor CONTEXTHUB driver.

source "drivers/contexthub/flp/Kconfig"
```

## drivers/cpuidle/Kconfig.arm64
```kconfig
#
# ARM64 CPU Idle drivers
#

config HISI_MULTIDRV_CPUIDLE
	bool "Generic Hisilicon Multiple Driver CPU idle Driver"
	select ARM64_CPU_SUSPEND
	select DT_IDLE_STATES
	help
	  Select this to enable generic cpuidle driver for Hisilicon.
	  It provides a generic idle driver whose idle states are configured
	  at run-time through DT nodes. The CPUidle suspend backend is
	  initialized by calling the CPU operations init idle hook
	  provided by architecture code.
```
